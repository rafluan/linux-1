## Documentation/devicetree/bindings/power/supply/tps65217_charger.txt
```
TPS65217 Charger

Required Properties:
-compatible: "ti,tps65217-charger"
-interrupts: TPS65217 interrupt numbers for the AC and USB charger input change.
             Should be <0> for the USB charger and <1> for the AC adapter.
-interrupt-names: Should be "USB" and "AC"

This node is a subnode of the tps65217 PMIC.

Optional properties:
- tps65217,mux-out: The voltage input that goes to the MUX_OUT pin. Possible
values are: 0, 1, 2, 3, 4 and 5 as per the table below:

0: MUX_OUT is put in High Impedance
1: MUX_OUT = VBAT
2: MUX_OUT = VSYS
3: MUX_OUT = VTS
4: MUX_OUT = VICH
5: MUX_OUT = MUX_IN

Example:

	tps65217-charger {
		compatible = "ti,tps65217-charger";
		interrupts = <0>, <1>;
		interrupt-names = "USB", "AC";
		tps65217,mux-out = <1>;	/* MUX_OUT = VBAT */
	};
```

## Documentation/devicetree/bindings/rtc/rtc-m41t80.txt
```
ST M41T80 family of RTC and compatible

Required properties:
- compatible: should be one of:
	"st,m41t62",
	"st,m41t65",
	"st,m41t80",
	"st,m41t81",
	"st,m41t81s",
	"st,m41t82",
	"st,m41t83",
	"st,m41t84",
	"st,m41t85",
	"st,m41t87",
	"microcrystal,rv4162",
- reg: I2C bus address of the device

Optional properties:
- interrupts: rtc alarm interrupt.
- clock-output-names: From common clock binding to override the default output
                      clock name
- wakeup-source: Enables wake up of host system on alarm
- st,use-tamper1: Use the TP1IN pin as tamper functionality. If not present,
TP1N pin is not used as tamper.
- st,use-tamper2: Use the TP2IN pin as tamper functionality. If not present,
TP2N pin is not used as tamper.
- st,tp1in-normally-open: Use TP1IN pin as a normally open switch. If not
present, use it as a normally closed switch.
- st,tp2in-normally-open: Use TP2IN pin as a normally open switch. If not
present, use it as a normally closed switch.
- st,tp1in-high: Detect TP1IN tamper event when it switches from low to high.
If not present, detect the tamper event when TP1IN changes from high to low.
- st,tp2in-high: Detect TP2IN event event when it switches from low to high.
If not present, detect the tamper event when TP2IN changes from high to low.

Example:
	rtc@68 {
		compatible = "st,m41t80";
		reg = <0x68>;
		interrupt-parent = <&UIC0>;
		interrupts = <0x9 0x8>;
	};
```
